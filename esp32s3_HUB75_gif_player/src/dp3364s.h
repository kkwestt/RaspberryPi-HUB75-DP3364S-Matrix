// DP3364S (Depuw S-PWM) HUB75 bitstream generator.
//
// Builds the exact clock-by-clock stream that drives 128x64 1/32-scan panels
// with DP3364S column drivers and a 138-type row decoder (direct A-E
// addressing). Every array element is the state of the parallel bus during one
// CLK period; the bus clock itself is generated by hardware (ESP32-S3 LCD_CAM
// PCLK), so timing does not depend on the CPU.
//
// The layout was reverse-engineered from a working Raspberry Pi setup
// (rpi-rgb-led-matrix S-PWM fork, see RaspberryPi-HUB75-DP3364S-Matrix) and is
// verified bit-for-bit against a capture of that stream (tools/verify_stream).
//
// Frame (one full refresh of all SRAM data):
//   VSYNC   : LAT high for 3 clocks
//   idle    : 17 clocks
//   scan    : data_clocks + tail_rows*128 clocks. A ROW pulse (HUB75 OE pin)
//             4 clocks wide starts every 128 clocks; the row address A-E
//             advances (0..31) at the same clock. During the first
//             data_clocks, 16 bits x chips are shifted per latch, MSB first;
//             after each such block one extra DATA_LATCH clock (LAT high,
//             1 clock) is inserted, which does not advance the scan counter.
// Register write (one per configuration register):
//   VSYNC(3) idle(17) PRE_ACT(LAT 14) idle(1) 16*chips data clocks with LAT
//   high on the last 5 (WR_CFG) idle(1)
#pragma once

#include <stddef.h>
#include <stdint.h>

namespace dp3364s {

// Bit positions on the 16-bit parallel bus (LCD data lines D0..D12).
enum : uint16_t {
  BIT_R1 = 1u << 0,
  BIT_G1 = 1u << 1,
  BIT_B1 = 1u << 2,
  BIT_R2 = 1u << 3,
  BIT_G2 = 1u << 4,
  BIT_B2 = 1u << 5,
  BIT_A = 1u << 6,
  BIT_B = 1u << 7,
  BIT_C = 1u << 8,
  BIT_D = 1u << 9,
  BIT_E = 1u << 10,
  BIT_LAT = 1u << 11,
  BIT_ROW = 1u << 12,  // HUB75 OE pin = DP3364S ROW input
};
constexpr uint16_t DATA_MASK = 0x003F;
constexpr int ADDR_SHIFT = 6;
constexpr int BUS_SIGNALS = 13;  // D0..D12

// Configuration registers (address << 8 | value), as written by the working
// Raspberry Pi setup. REG02 = scan lines - 1 (0x1F = 32 lines).
constexpr uint16_t DEFAULT_REGISTERS[] = {
    0x1100, 0x021F, 0x033F, 0x043F, 0x0504, 0x0642, 0x0700,
    0x08BF, 0x0960, 0x0ABE, 0x0B8B, 0x0C08, 0x0D12,
};
constexpr int DEFAULT_REGISTER_COUNT = sizeof(DEFAULT_REGISTERS) / sizeof(DEFAULT_REGISTERS[0]);

struct Layout {
  int panels = 2;          // 128x64 panels daisy-chained on one connector
  int scan_rows = 32;      // 1/32 scan
  int row_period = 128;    // clocks per ROW pulse
  int row_pulse = 4;       // ROW pulse width (W4)
  int vsync_idle = 17;     // clocks between VSYNC and the first scan clock
  int tail_rows = 64;      // ROW pulses after the last data latch
  int pad_end = 0;         // extra idle clocks at the end of a frame (alignment)

  int width() const { return 128 * panels; }
  int height() const { return 64; }
  int chips() const { return 8 * panels; }            // DP3364S per data line
  int block_clocks() const { return 16 * chips(); }   // bits shifted per latch
  int latches() const { return scan_rows * 16; }      // line x channel
  int data_clocks() const { return latches() * block_clocks(); }
  int scan_clocks() const { return data_clocks() + tail_rows * row_period; }
  size_t frame_words() const {
    return 3 + vsync_idle + scan_clocks() + latches() + pad_end;
  }
  size_t register_block_words() const { return 3 + 17 + 14 + 1 + block_clocks() + 1; }
  // Buffer index of data clock i (0..block_clocks-1) of latch k.
  size_t data_index(int latch, int i) const {
    return 3 + vsync_idle + static_cast<size_t>(latch) * (block_clocks() + 1) + i;
  }
};

// Fill one frame with the control signals (VSYNC, ROW, A-E, DATA_LATCH) and
// zero pixel data. Pixel data is filled later by encode_frame().
void build_frame(uint16_t *out, const Layout &l);

// One configuration register write; returns the number of words written
// (= l.register_block_words()).
size_t build_register_block(uint16_t *out, const Layout &l, uint16_t reg);

// 8-bit colour -> 12-bit S-PWM word (CIE 1931 lightness, 11-bit PWM aligned to
// the 12-bit range the driver displays with REG03 = REG04 = 0x3F).
void build_gamma_lut(uint16_t lut[256], int brightness_percent = 100);

// Writes pixel data into a frame built by build_frame(), preserving the
// control bits. get(x, y, rgb) must return 8-bit R, G, B for 0 <= x < width,
// 0 <= y < 64.
template <typename GetPixel>
void encode_frame(uint16_t *frame, const Layout &l, const uint16_t lut[256], GetPixel get) {
  const int lines = l.scan_rows;
  const int slots = l.chips();
  uint16_t w[16 * 8 * 6];  // up to 8 panels: slots * 6 words
  for (int line = 0; line < lines; ++line) {
    for (int ch = 0; ch < 16; ++ch) {
      // gather the 6 colour words (upper R,G,B and lower R,G,B) per slot
      for (int s = 0; s < slots; ++s) {
        const int x = s * 16 + ch;
        uint8_t up[3], lo[3];
        get(x, line, up);
        get(x, line + lines, lo);
        uint16_t *p = &w[s * 6];
        p[0] = lut[up[0]]; p[1] = lut[up[1]]; p[2] = lut[up[2]];
        p[3] = lut[lo[0]]; p[4] = lut[lo[1]]; p[5] = lut[lo[2]];
      }
      uint16_t *dst = frame + l.data_index(line * 16 + ch, 0);
      for (int s = 0; s < slots; ++s) {
        const uint16_t *p = &w[s * 6];
        for (int b = 15; b >= 0; --b) {
          const uint16_t bits = ((p[0] >> b) & 1) | (((p[1] >> b) & 1) << 1) |
                                (((p[2] >> b) & 1) << 2) | (((p[3] >> b) & 1) << 3) |
                                (((p[4] >> b) & 1) << 4) | (((p[5] >> b) & 1) << 5);
          *dst = static_cast<uint16_t>((*dst & ~DATA_MASK) | bits);
          ++dst;
        }
      }
    }
  }
}

}  // namespace dp3364s
